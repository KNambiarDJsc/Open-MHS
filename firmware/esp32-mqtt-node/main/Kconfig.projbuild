## firmware/esp32-mqtt-node/main/Kconfig.projbuild
```kconfig
menu "OpenMHS node"

    config NODE_BROKER_URI
        string "MQTT broker URI"
        default "mqtt://10.0.2.2:18830"
        help
            10.0.2.2 is the host as seen from QEMU's user-mode network.

    config NODE_SNTP_SERVER
        string "SNTP server"
        default "10.0.2.2"

    config NODE_CLOCK_FROM_MQTT
        bool "Take the time from an MQTT message instead of SNTP"
        default n
        help
            For QEMU, where the host's UDP port 123 is often in use. The node publishes
            <prefix>/hello after connecting and waits for <prefix>/clock.

    config NODE_TOPIC_PREFIX
        string "Topic prefix"
        default "esp32/node-01"

    config NODE_LED_GPIO
        int "GPIO driven by led.on"
        default 2

endmenu
```

## firmware/esp32-mqtt-node/sdkconfig.defaults
```kconfig
CONFIG_IDF_TARGET="esp32"
CONFIG_ESPTOOLPY_FLASHSIZE_4MB=y
CONFIG_EXAMPLE_CONNECT_ETHERNET=y
CONFIG_EXAMPLE_CONNECT_WIFI=n
CONFIG_EXAMPLE_USE_OPENETH=y
CONFIG_EXAMPLE_CONNECT_IPV6=n
CONFIG_ETH_USE_OPENETH=y
CONFIG_ETH_OPENETH_DMA_RX_BUFFER_NUM=4
CONFIG_ETH_OPENETH_DMA_TX_BUFFER_NUM=1
CONFIG_LOG_DEFAULT_LEVEL_INFO=y
CONFIG_NODE_CLOCK_FROM_MQTT=y
```
